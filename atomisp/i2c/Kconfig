## atomisp/i2c/Kconfig
```kconfig
#
# Kconfig for sensor drivers
#

config VIDEO_OV2722
       tristate "OVT ov2722 sensor support"
       depends on I2C && VIDEO_V4L2
       ---help---
         This is a Video4Linux2 sensor-level driver for the OVT
         OV2722 raw camera.

         OVT is a 2M raw sensor.

         It currently only works with the atomisp driver.
```
